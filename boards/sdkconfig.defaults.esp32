## boards/sdkconfig.defaults.esp32s3
```kconfig
# Generic ESP32-S3 DevKit.
# Target: idf.py set-target esp32s3

CONFIG_IDF_TARGET="esp32s3"

CONFIG_ALIRO_NFC_SPI_SCK=12
CONFIG_ALIRO_NFC_SPI_MISO=13
CONFIG_ALIRO_NFC_SPI_MOSI=11
CONFIG_ALIRO_NFC_SPI_CS=10

CONFIG_ALIRO_LOCK_GPIO=2
CONFIG_ALIRO_READER_TASK_CORE=1
```

## components/aliro_reader/Kconfig
```kconfig
menu "Aliro reader"

config ALIRO_READER_TASK_STACK_SIZE
    int "Reader task stack size (bytes)"
    default 8192
    help
        The Aliro transaction runs ECDH, ECDSA and AES-GCM on this task's
        stack. 8 KB is the size Espressif's own reference example uses.

config ALIRO_READER_TASK_PRIORITY
    int "Reader task priority"
    default 18
    help
        A tap has a hard real-time budget: the user device is only in the
        field while someone holds a phone to the reader. Keep this above
        housekeeping work.

config ALIRO_READER_TASK_CORE
    int "Reader task core"
    default 0
    range 0 1
    help
        Core to pin the reader task to. Ignored on single-core targets.

config ALIRO_READER_POLL_INTERVAL_MS
    int "Polling interval when no device is present (ms)"
    default 100

config ALIRO_READER_FAST_TRANSACTION_SLOTS
    int "Persistent fast-transaction key slots"
    default 20
    help
        Fast transactions skip the full handshake for a device that has
        already been seen, which is the difference between a tap that feels
        instant and one that does not. 0 disables fast transactions.

endmenu
```

## components/app_config/Kconfig
```kconfig
menu "Aliro configuration defaults"

comment "Applied on first boot and after a config reset. Edit at runtime in the web UI."

config ALIRO_DEFAULT_DEVICE_NAME
    string "Device name"
    default "aliro-homekey"

config ALIRO_READER_GROUP_ID
    string "Reader group identifier (32 hex chars)"
    default "00112233445566778899AABBCCDDEEFF"
    help
        16-byte Reader Group Identifier. Identifies this installation to user
        devices; every reader in the same lock group shares it. Change it
        before deploying anything real.

menu "NFC frontend"

# Per target, because the ESP32 defaults are not merely a poor fit elsewhere:
# GPIO 23 does not exist on the C3 at all, so a C3 image carrying them would
# build, boot, and then fail to bring up the reader with nothing in the log to
# say the pin was imaginary. The C3 numbers below avoid its flash pins (12-17)
# and its strapping pins (2, 8, 9); the C6 and H2 avoid theirs.

config ALIRO_NFC_SPI_SCK
    int "SPI SCK"
    default 4 if IDF_TARGET_ESP32C3
    default 6 if IDF_TARGET_ESP32C6 || IDF_TARGET_ESP32H2
    default 18

config ALIRO_NFC_SPI_MISO
    int "SPI MISO"
    default 5 if IDF_TARGET_ESP32C3
    default 7 if IDF_TARGET_ESP32C6 || IDF_TARGET_ESP32H2
    default 19

config ALIRO_NFC_SPI_MOSI
    int "SPI MOSI"
    default 6 if IDF_TARGET_ESP32C3
    default 10 if IDF_TARGET_ESP32C6 || IDF_TARGET_ESP32H2
    default 23

config ALIRO_NFC_SPI_CS
    int "SPI CS"
    default 7 if IDF_TARGET_ESP32C3
    default 11 if IDF_TARGET_ESP32C6 || IDF_TARGET_ESP32H2
    default 5

config ALIRO_NFC_ECP_BEACON
    bool "Emit the Apple ECP beacon during NFC polling"
    default y
    help
        Broadcasts an 18-byte Apple ECP frame naming this reader and the Aliro
        profile, which is what lets a locked phone offer its credential without
        the wallet being opened. Without it a tap needs the key picked in
        Wallet first.

        The PN532 sends it after an empty Type-A poll, using that poll to set up
        the radio and resetting CIU_BitFraming to eight bits before the raw ECP
        frame. Disable this only when debugging NFC polling or when Apple
        Wallet support is not needed.

config ALIRO_NFC_IRQ
    int "IRQ pin (-1 if unused)"
    default -1

config ALIRO_NFC_RST
    int "Reset / VEN pin (-1 if unused)"
    default -1

endmenu

menu "Lock output"

config ALIRO_LOCK_GPIO
    int "Lock output GPIO"
    default 2
    help
        GPIO driving the relay, strike or lock driver. On a bare DevKit this
        can stay on the on-board LED pin for bring-up.

config ALIRO_LOCK_ACTIVE_LOW
    bool "Lock output is active low"
    default n
    help
        Most relay boards for the ESP32 are active low.

config ALIRO_LOCK_UNLOCK_MS
    int "Unlock duration (ms)"
    default 3000

endmenu

menu "Network"

config ALIRO_AP_PASSWORD
    string "Setup access point password (>= 8 chars)"
    default "aliro1234"
    help
        The device starts this access point when it has no Wi-Fi credentials
        or cannot join. Connect to it to reach the configuration UI.

endmenu

config ALIRO_MAX_CREDENTIALS
    int "Maximum registered credentials"
    default 8
    help
        Foundation-phase credential store: a fixed in-memory table, populated
        at boot. Persistent storage and enrollment replace it later.

endmenu
```

## components/matter_lock/Kconfig
```kconfig
menu "Aliro Matter"

config ALIRO_MATTER_ENABLE
    bool "Expose the reader as a Matter Door Lock"
    default n
    help
        Present this device to Matter controllers as a Door Lock (cluster
        0x0101) with the Aliro provisioning feature, so a phone ecosystem can
        hand it a reader key pair and enroll endpoint keys the standard way.

        Requires esp-matter: build inside the espressif/esp-matter container,
        or set ESP_MATTER_PATH before running idf.py. Adds roughly 1.5 MB to
        the application, so check that the image still fits the OTA slot.

        Taps themselves do not go through Matter. NFC and the Aliro
        transaction work exactly the same with this off.

endmenu
```

## components/pn532_m5nfc/Kconfig
```kconfig
menu "PN532 NFC frontend"

    choice PN532_BUS
        prompt "Bus"
        default PN532_BUS_SPI
        help
            How the PN532 module is wired. Most breakout boards have a pair of
            DIP switches selecting this on the module itself; they must agree.

        config PN532_BUS_SPI
            bool "SPI"
        config PN532_BUS_I2C
            bool "I2C"
    endchoice

    config PN532_SPI_HOST
        int "SPI host (1 = SPI2, 2 = SPI3)"
        depends on PN532_BUS_SPI
        range 1 2
        default 1

    config PN532_SPI_SCK
        int "SCK pin"
        depends on PN532_BUS_SPI
        default 18

    config PN532_SPI_MISO
        int "MISO pin"
        depends on PN532_BUS_SPI
        default 19

    config PN532_SPI_MOSI
        int "MOSI pin"
        depends on PN532_BUS_SPI
        default 23

    config PN532_SPI_CS
        int "CS pin"
        depends on PN532_BUS_SPI
        default 5

    config PN532_SPI_FREQ_HZ
        int "SPI clock (Hz)"
        depends on PN532_BUS_SPI
        default 1000000
        help
            The PN532 is specified to 5 MHz. 1 MHz is a safe default for the
            jumper wires these modules are usually attached with.

    config PN532_I2C_SDA
        int "SDA pin"
        depends on PN532_BUS_I2C
        default 21

    config PN532_I2C_SCL
        int "SCL pin"
        depends on PN532_BUS_I2C
        default 22

    config PN532_I2C_FREQ_HZ
        int "I2C clock (Hz)"
        depends on PN532_BUS_I2C
        default 100000

    config PN532_I2C_ADDR
        hex "I2C address"
        depends on PN532_BUS_I2C
        default 0x24

    config PN532_RST_PIN
        int "RSTPD_N pin, or -1 if not wired"
        default -1
        help
            Pulsed low at start-up to recover a wedged chip. Leave at -1 when
            the module's reset line is not connected.

endmenu
```

## components/serial_console/Kconfig
```kconfig
menu "Aliro serial console"

config ALIRO_CONSOLE_ENABLE
    bool "Interactive serial console"
    default y
    help
        The `aliro>` REPL on the serial port: status, identity, wifi,
        unlock, factory-reset.

        Turn this off for a build that runs the Matter stack. Starting the
        REPL installs the driver-based UART VFS, after which every ESP_LOG
        from every task goes through the UART driver and takes a mutex. With
        chip, NimBLE and Wi-Fi all logging concurrently, that path asserts
        inside a blocking semaphore take -- and since the panic handler logs
        too, it re-enters and recurses until the stack is gone.

        Everything the console does is also in the web UI, including the log
        view, so this costs a convenience rather than a capability.

endmenu
```

## components/web_server/Kconfig
```kconfig
menu "Web Server"

config HTTPD_WS_SUPPORT
    bool "Enable WebSocket support"
    default y
    help
        Enable WebSocket support in HTTP server for real-time updates.

config ALIRO_WS_MAX_CLIENTS
    int "Maximum WebSocket clients"
    default 4
    range 1 16
    help
        Maximum number of simultaneous WebSocket connections.

config ALIRO_OTA_MAX_SIZE
    int "Maximum OTA firmware size (bytes)"
    default 2097152
    help
        Maximum size allowed for firmware OTA updates (default 2MB).

endmenu
```
